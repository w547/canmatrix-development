VERSION ""

NS_ :

BS_:

BU_:

BO_ 100 TestFrame: 8 Vector__XXX
 SG_ TestSignal : 0|32@1- (1,0) [-2147483648|2147483647] "" Vector__XXX

BA_DEF_ SG_ "GenSigStartValue" FLOAT -2147483648 2147483647;

BA_ "GenSigStartValue" SG_ 100 TestSignal -2147483648;

BA_DEF_DEF_ "GenSigStartValue" 0;
