VERSION ""

NS_ :

BS_:

BU_: ECU1

BO_ 100 Frame1: 8 ECU1
 SG_ Signal1 : 0|8@1+ (1,0) [0|255] "" ECU1

CM_ SG_ 100 Signal1 "这是一个中文测试信号";
CM_ BO_ 100 "这是一个中文测试帧";
